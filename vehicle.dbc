VERSION ""

NS_ :

BS_:

BU_: ECU_Gateway Dashboard

BO_ 256 VehicleStatus: 8 ECU_Gateway
 SG_ VehicleSpeed : 0|16@1+ (0.01,0) [0|120] "km/h" Dashboard
 SG_ EngineRPM : 16|16@1+ (1,0) [800|5000] "rpm" Dashboard

BO_ 257 ThermalFuel: 8 ECU_Gateway
 SG_ CoolantTemperature : 32|11@1+ (0.1,-40) [-40|120] "degC" Dashboard
 SG_ FuelLevel : 48|8@1+ (0.5,0) [0|100] "%" Dashboard

BO_ 258 PowerStatus: 8 ECU_Gateway
 SG_ BatteryVoltage : 0|12@1+ (0.01,0) [11|15] "V" Dashboard
 SG_ AmbientTemperature : 24|8@1+ (1,-40) [-40|100] "degC" Dashboard

CM_ BU_ ECU_Gateway "Virtual ECU telemetry source for the SocketCAN demonstration.";
CM_ BU_ Dashboard "Software dashboard that decodes the three CAN frames.";
CM_ BO_ 256 "Vehicle speed occupies bits 0-15; engine speed occupies bits 16-31.";
CM_ BO_ 257 "Thermal and fuel values use a separated 32-bit signal start to demonstrate non-contiguous frame organization.";
CM_ BO_ 258 "Battery voltage and ambient temperature are deliberately placed at different bit offsets from the other frames.";
CM_ SG_ 256 VehicleSpeed "Physical value = raw x 0.01.";
CM_ SG_ 256 EngineRPM "Physical value = raw x 1.0.";
CM_ SG_ 257 CoolantTemperature "Physical value = raw x 0.1 - 40.";
CM_ SG_ 257 FuelLevel "Physical value = raw x 0.5.";
CM_ SG_ 258 BatteryVoltage "Physical value = raw x 0.01.";
CM_ SG_ 258 AmbientTemperature "Physical value = raw - 40.";

VAL_ 256 VehicleSpeed 0 "Stopped";
